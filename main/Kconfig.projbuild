## main/Kconfig.projbuild
```kconfig
menu "SPI LCD Configuration"

    choice LCD_CONTROLLER
        prompt "LCD controller model"
        default LCD_CONTROLLER_ILI9341
        help
            Select LCD controller model


        config LCD_CONTROLLER_ILI9488
            bool "ILI9488"
        config LCD_CONTROLLER_ILI9341
            bool "ILI9341"

        config LCD_CONTROLLER_GC9A01
            bool "GC9A01"
    endchoice

    config LCD_TOUCH_ENABLED
        bool "Enable LCD touch controller"
        default n
        help
            Enable this option if you wish to use display touch. You can select from touch controllers.

    choice LCD_TOUCH_CONTROLLER
        prompt "LCD touch controller model"
        depends on LCD_TOUCH_ENABLED
        default LCD_TOUCH_CONTROLLER_XPT2046
        help
            Select LCD touch controller model

        config LCD_TOUCH_CONTROLLER_XPT2046
            bool "XPT2046"
            help
                Touch controller XPT2046 connected via SPI.
    endchoice
endmenu
```
